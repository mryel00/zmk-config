ZMK_LAYER(mc,
//╭─────────────┬─────────────┬─────────────┬─────────────┬─────────────┬─────────────╮ ╭─────────────┬─────────────┬─────────────┬─────────────┬─────────────┬─────────────╮
    &kp ESC       &kp Q         &kp W         &kp E         &kp GRAVE     &kp T           &kp Y         &kp N1        &kp N2        &kp N3        XXX           &to DEF
//├─────────────┼─────────────┼─────────────┼─────────────┼─────────────┼─────────────┤ ├─────────────┼─────────────┼─────────────┼─────────────┼─────────────┼─────────────┤
    &kp LSHFT     &kp A         &kp S         &kp D         &kp F         &kp G           &kp N0        &kp N4        &kp N5        &kp N6        XXX           &kp SQT
//├─────────────┼─────────────┼─────────────┼─────────────┼─────────────┼─────────────┤ ├─────────────┼─────────────┼─────────────┼─────────────┼─────────────┼─────────────┤
    &kp LCTRL     &kp Z         &kp X         &kp C         &kp V         &kp B           &kp FSLH      &kp N7        &kp N8        &kp N9        XXX           &kp BSPC
//╰─────────────┴─────────────┴─────────────┼─────────────┼─────────────┼─────────────┤ ├─────────────┼─────────────┼─────────────┼─────────────┴─────────────┴─────────────╯
                                              &kp LALT      &kp M         &kp SPACE       XXX           XXX           XXX
//                                          ╰─────────────┴─────────────┴─────────────╯ ╰─────────────┴─────────────┴─────────────╯
)

// ZMK_LAYER(mc2,
// //╭─────────────┬─────────────┬─────────────┬─────────────┬─────────────┬─────────────╮ ╭─────────────┬─────────────┬─────────────┬─────────────┬─────────────┬─────────────╮
//     ___           &kp N1        &kp N2        &kp N3        ___           ___             ___           ___           ___           ___           ___           &to DEF
// //├─────────────┼─────────────┼─────────────┼─────────────┼─────────────┼─────────────┤ ├─────────────┼─────────────┼─────────────┼─────────────┼─────────────┼─────────────┤
//     &kp N0        &kp N4        &kp N5        &kp N6        ___           ___             ___           ___           ___           ___           ___           ___
// //├─────────────┼─────────────┼─────────────┼─────────────┼─────────────┼─────────────┤ ├─────────────┼─────────────┼─────────────┼─────────────┼─────────────┼─────────────┤
//     ___           &kp N7        &kp N8        &kp N9        ___           ___             ___           ___           ___           ___           ___           ___
// //╰─────────────┴─────────────┴─────────────┼─────────────┼─────────────┼─────────────┤ ├─────────────┼─────────────┼─────────────┼─────────────┴─────────────┴─────────────╯
//                                               &to GAMING1   ___           &sl GAMING2     ___           ___           ___
// //                                          ╰─────────────┴─────────────┴─────────────╯ ╰─────────────┴─────────────┴─────────────╯
// )

// ZMK_LAYER(mc3,
// //╭─────────────┬─────────────┬─────────────┬─────────────┬─────────────┬─────────────╮ ╭─────────────┬─────────────┬─────────────┬─────────────┬─────────────┬─────────────╮
//     &kp TAB       &kp P         &kp O         &kp I         &kp U         &kp Y           ___           ___           ___           ___           ___           &to DEF
// //├─────────────┼─────────────┼─────────────┼─────────────┼─────────────┼─────────────┤ ├─────────────┼─────────────┼─────────────┼─────────────┼─────────────┼─────────────┤
//     &kp SQT       &kp SEMI      &kp L         &kp K         &kp J         &kp H           ___           ___           ___           ___           ___           ___
// //├─────────────┼─────────────┼─────────────┼─────────────┼─────────────┼─────────────┤ ├─────────────┼─────────────┼─────────────┼─────────────┼─────────────┼─────────────┤
//     &kp BSPC      &kp FSLH      &kp DOT       &kp COMMA     &kp M         &kp N           ___           ___           ___           ___           ___           ___
// //╰─────────────┴─────────────┴─────────────┼─────────────┼─────────────┼─────────────┤ ├─────────────┼─────────────┼─────────────┼─────────────┴─────────────┴─────────────╯
//                                               ___           ___           ___             ___           ___           ___
// //                                          ╰─────────────┴─────────────┴─────────────╯ ╰─────────────┴─────────────┴─────────────╯
// )
