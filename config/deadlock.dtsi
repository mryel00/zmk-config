ZMK_LAYER(deadlock,
//╭─────────────┬─────────────┬─────────────┬─────────────┬─────────────┬─────────────╮ ╭─────────────┬─────────────┬─────────────┬─────────────┬─────────────┬─────────────╮
    &kp TAB       &kp Q         &kp W         &kp N2        &kp R         &kp T           &kp Y         &kp N1        &kp N2        &kp N3        XXX           &to DEF
//├─────────────┼─────────────┼─────────────┼─────────────┼─────────────┼─────────────┤ ├─────────────┼─────────────┼─────────────┼─────────────┼─────────────┼─────────────┤
    &kp N3        &kp A         &kp S         &kp D         &kp N4        &kp F           &kp N0        &kp N4        &kp N5        &kp N6        XXX           &kp SQT
//├─────────────┼─────────────┼─────────────┼─────────────┼─────────────┼─────────────┤ ├─────────────┼─────────────┼─────────────┼─────────────┼─────────────┼─────────────┤
    &kp LSHFT     &kp Z         &kp X         &kp C         &kp V         &kp B           &kp FSLH      &kp N7        &kp N8        &kp N9        XXX           &kp BSPC
//╰─────────────┴─────────────┴─────────────┼─────────────┼─────────────┼─────────────┤ ├─────────────┼─────────────┼─────────────┼─────────────┴─────────────┴─────────────╯
                                              &kp LCTRL     &kp N1         &kp SPACE       XXX           XXX           XXX
//                                          ╰─────────────┴─────────────┴─────────────╯ ╰─────────────┴─────────────┴─────────────╯
)
