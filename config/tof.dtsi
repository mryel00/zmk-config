ZMK_MACRO_ONE_PARAM(alt_tap,
    wait-ms = <40>;
    tap-ms = <40>;
    bindings =  <&macro_press &kp LALT>,
                <&macro_param_1to1>, <&macro_tap &kp MACRO_PLACEHOLDER>,
                <&macro_release &kp LALT>;
)

ZMK_LAYER(tof,
//╭─────────────┬─────────────┬─────────────┬─────────────┬─────────────┬─────────────╮ ╭─────────────┬─────────────┬─────────────┬─────────────┬─────────────┬─────────────╮
    &kp ESC       &kp Q         &kp W         &kp E         &kp R         &kp X           &kp L         XXX           XXX           XXX           XXX           &to DEF
//├─────────────┼─────────────┼─────────────┼─────────────┼─────────────┼─────────────┤ ├─────────────┼─────────────┼─────────────┼─────────────┼─────────────┼─────────────┤
    &kp TAB       &kp A         &kp S         &kp D         &kp F         &kp G           &kp F5        &alt_tap N1   &alt_tap N2   &alt_tap N3   &alt_tap N4   XXX
//├─────────────┼─────────────┼─────────────┼─────────────┼─────────────┼─────────────┤ ├─────────────┼─────────────┼─────────────┼─────────────┼─────────────┼─────────────┤
    &kp LSHFT     &kp N1        &kp V        &kp N2         &kp N3        &kp F2          &kp C         &kp Z         &kp B         &kp N         XXX           XXX
//╰─────────────┴─────────────┴─────────────┼─────────────┼─────────────┼─────────────┤ ├─────────────┼─────────────┼─────────────┼─────────────┴─────────────┴─────────────╯
                                              &kp LALT      &kp M         &kp SPACE       &kp T         &kp LCTRL     XXX
//                                          ╰─────────────┴─────────────┴─────────────╯ ╰─────────────┴─────────────┴─────────────╯
)
