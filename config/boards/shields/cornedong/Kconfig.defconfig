## config/boards/shields/cornedong/Kconfig.defconfig
```kconfig
if SHIELD_CORNEDONG_LEFT

config ZMK_KEYBOARD_NAME
    default "Cornedong"

config ZMK_SPLIT_BLE_ROLE_CENTRAL
    default y

config ZMK_USB
    default y

endif

if SHIELD_CORNEDONG_LEFT || SHIELD_CORNEDONG_RIGHT
config ZMK_SPLIT
    default y

config ZMK_BLE
    default y

config ZMK_LOW_PRIORITY_WORK_QUEUE
    default y

endif
```

## config/boards/shields/cornedong/Kconfig.shield
```kconfig
config SHIELD_CORNEDONG_LEFT
    def_bool $(shields_list_contains,cornedong_left)

config SHIELD_CORNEDONG_RIGHT
    def_bool $(shields_list_contains,cornedong_right)

config SHIELD_CORNEDONG_DONGLE
	def_bool $(shields_list_contains,cornedong_dongle)
```

## config/west.yml
```yaml
manifest:
  defaults:
    remote: urob
    revision: v0.3
  remotes:
    - name: zmkfirmware
      url-base: https://github.com/zmkfirmware
    - name: urob
      url-base: https://github.com/urob
    - name: badjeff
      url-base: https://github.com/badjeff
    - name: mryel00
      url-base: https://github.com/mryel00
  projects:
    - name: zmk
      remote: zmkfirmware
      import: app/west.yml
    # https://github.com/mryel00/zmk-memory-layer
    - name: zmk-memory-layer
      path: modules/zmk/memory-layer
      remote: mryel00
      revision: main
    # https://github.com/urob/zmk-helpers
    - name: zmk-helpers
      path: modules/zmk/helpers
    # https://github.com/urob/zmk-auto-layer
    - name: zmk-auto-layer
      path: modules/zmk/auto-layer
    # https://github.com/urob/zmk-tri-state
    - name: zmk-tri-state
      path: modules/zmk/tri-state
    # https://github.com/urob/zmk-leader-key
    - name: zmk-leader-key
      path: modules/zmk/leader-key
    - name: zmk-behavior-key-tempo
      remote: badjeff
      revision: main
      path: modules/zmk/tempo
    - name: zephyr
      revision: v3.5.0+zmk-fixes
      remote: zmkfirmware
      clone-depth: 1
      import:
        # Only enable most commonly used boards. For less common hardware one
        # may need to enable additional modules.
        name-allowlist:
          - cmsis
          - hal_nordic
          - hal_rpi_pico
          - hal_stm32
          - lvgl
          - tinycrypt
  self:
    path: config
```
