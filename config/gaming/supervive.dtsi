ZMK_LAYER(supervive,
//╭─────────────┬─────────────┬─────────────┬─────────────┬─────────────┬─────────────╮ ╭─────────────┬─────────────┬─────────────┬─────────────┬─────────────┬─────────────╮
    &kp TAB       &kp Q         &kp W         &kp E         &kp R         &kp T           XXX           XXX           XXX           XXX           XXX           &to DEF
//├─────────────┼─────────────┼─────────────┼─────────────┼─────────────┼─────────────┤ ├─────────────┼─────────────┼─────────────┼─────────────┼─────────────┼─────────────┤
    &kp LCTRL     &kp A         &kp S         &kp D         &kp F         &kp G           XXX           XXX           XXX           XXX           XXX           XXX
//├─────────────┼─────────────┼─────────────┼─────────────┼─────────────┼─────────────┤ ├─────────────┼─────────────┼─────────────┼─────────────┼─────────────┼─────────────┤
    &kp LSHFT     &kp N1        &kp V         &kp N2        &kp N3        XXX             XXX           XXX           XXX           XXX           XXX           XXX
//╰─────────────┴─────────────┴─────────────┼─────────────┼─────────────┼─────────────┤ ├─────────────┼─────────────┼─────────────┼─────────────┴─────────────┴─────────────╯
                                              &kp LALT      XXX           &kp SPACE       &kp F1        &kp M         XXX
//                                          ╰─────────────┴─────────────┴─────────────╯ ╰─────────────┴─────────────┴─────────────╯
)
