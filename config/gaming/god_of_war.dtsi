ZMK_MACRO(throw,
    bindings = <&kp R>,
    <&macro_press &kp LCTRL>,
    <&macro_pause_for_release>,
    <&macro_release &kp LCTRL>;
)

ZMK_LAYER(gow,
//╭─────────────┬─────────────┬─────────────┬─────────────┬─────────────┬─────────────╮ ╭─────────────┬─────────────┬─────────────┬─────────────┬─────────────┬─────────────╮
    &kp ESC       &kp Q         &kp W         &kp E         XXX           &kp I           XXX           XXX           XXX           XXX           XXX           &to DEF
//├─────────────┼─────────────┼─────────────┼─────────────┼─────────────┼─────────────┤ ├─────────────┼─────────────┼─────────────┼─────────────┼─────────────┼─────────────┤
    &kp LSHFT     &kp A         &kp S         &kp D         &kp F         &kp K           XXX           XXX           XXX           XXX           XXX           XXX
//├─────────────┼─────────────┼─────────────┼─────────────┼─────────────┼─────────────┤ ├─────────────┼─────────────┼─────────────┼─────────────┼─────────────┼─────────────┤
    &kp SPACE     &kp N1        &kp H         &kp N5        &kp M         &kp J           XXX           XXX           XXX           XXX           XXX           XXX
//╰─────────────┴─────────────┴─────────────┼─────────────┼─────────────┼─────────────┤ ├─────────────┼─────────────┼─────────────┼─────────────┴─────────────┴─────────────╯
                                              &kp F         &kp LCTRL     &throw          XXX           XXX           XXX
//                                          ╰─────────────┴─────────────┴─────────────╯ ╰─────────────┴─────────────┴─────────────╯
)
