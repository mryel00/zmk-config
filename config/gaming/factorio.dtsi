ZMK_TAP_DANCE(flip,
    tapping-term-ms = <200>;
    bindings = <&kp V>, <&kp H>;
)

ZMK_COMBO(pause, &kp PAUSE_BREAK, LT3 LT2 LT1, FAC, COMBO_TERM_FAST, COMBO_IDLE_FAST)

ZMK_LAYER(factorio,
//╭─────────────┬─────────────┬─────────────┬─────────────┬─────────────┬─────────────╮ ╭─────────────┬─────────────┬─────────────┬─────────────┬─────────────┬─────────────╮
    &kp TAB       &kp Q         &kp W         &kp E         &kp R         &kp Z           &kp T         &kp P         &kp L         &kp O         XXX           &chat_toggle
//├─────────────┼─────────────┼─────────────┼─────────────┼─────────────┼─────────────┤ ├─────────────┼─────────────┼─────────────┼─────────────┼─────────────┼─────────────┤
    &kp LSHFT     &kp A         &kp S         &kp D         &kp F         &kp G           &kp LEFT      &kp DOWN      &kp UP        &kp RIGHT     XXX           XXX
//├─────────────┼─────────────┼─────────────┼─────────────┼─────────────┼─────────────┤ ├─────────────┼─────────────┼─────────────┼─────────────┼─────────────┼─────────────┤
    &kp LCTRL     &kp Y         &kp X         &kp C         &flip         &kp B           XXX           XXX           XXX           XXX           XXX           XXX
//╰─────────────┴─────────────┴─────────────┼─────────────┼─────────────┼─────────────┤ ├─────────────┼─────────────┼─────────────┼─────────────┴─────────────┴─────────────╯
                                              &kp LALT      &sl FAC_Q     &kp SPACE       XXX           &kp KP_MINUS  &kp KP_PLUS
//                                          ╰─────────────┴─────────────┴─────────────╯ ╰─────────────┴─────────────┴─────────────╯
)

ZMK_LAYER(factorio_quickbar,
//╭─────────────┬─────────────┬─────────────┬─────────────┬─────────────┬─────────────╮ ╭─────────────┬─────────────┬─────────────┬─────────────┬─────────────┬─────────────╮
    ___           &kp N7        &kp N8        &kp N9        &kp LA(L)     &kp F1          ___           ___           ___           ___           ___           ___
//├─────────────┼─────────────┼─────────────┼─────────────┼─────────────┼─────────────┤ ├─────────────┼─────────────┼─────────────┼─────────────┼─────────────┼─────────────┤
    &kp N0        &kp N4        &kp N5        &kp N6        &kp LA(U)     &kp F2          ___           ___           ___           ___           ___           ___
//├─────────────┼─────────────┼─────────────┼─────────────┼─────────────┼─────────────┤ ├─────────────┼─────────────┼─────────────┼─────────────┼─────────────┼─────────────┤
    ___           &kp N1        &kp N2        &kp N3        &kp LA(T)     &kp F3          ___           ___           ___           ___           ___           ___
//╰─────────────┴─────────────┴─────────────┼─────────────┼─────────────┼─────────────┤ ├─────────────┼─────────────┼─────────────┼─────────────┴─────────────┴─────────────╯
                                              ___           ___           ___             ___           ___           ___
//                                          ╰─────────────┴─────────────┴─────────────╯ ╰─────────────┴─────────────┴─────────────╯
)

